## firmware_nodo_OpenThread/sdkconfig.defaults
```kconfig
# Target
CONFIG_IDF_TARGET="esp32c6"

# OpenThread + 802.15.4
CONFIG_OPENTHREAD_ENABLED=y
CONFIG_OPENTHREAD_BORDER_ROUTER=n
CONFIG_OPENTHREAD_CONSOLE_ENABLE=n
CONFIG_IEEE802154_ENABLED=y

# lwIP
CONFIG_LWIP_IPV4=n
CONFIG_LWIP_IPV6=y
CONFIG_LWIP_IPV6_NUM_ADDRESSES=8

# Timekeeping compatible with deep sleep cycles
CONFIG_LIBC_TIME_SYSCALL_USE_RTC_HRT=y
CONFIG_RTC_CLK_SRC_INT_RC=y
CONFIG_BOOTLOADER_SKIP_VALIDATE_IN_DEEP_SLEEP=y
```

## firmware_nodo_ble/sdkconfig.defaults
```kconfig
# Target
CONFIG_IDF_TARGET="esp32c6"

# Habilitar BLE (Bluetooth Low Energy)
CONFIG_BT_ENABLED=y
CONFIG_BT_BLUEDROID_ENABLED=y
CONFIG_BT_BLE_ENABLED=y

# Deshabilitar Classic BT (no lo usamos, ahorra memoria)
CONFIG_BT_CLASSIC_ENABLED=n

# BLE GATT — tamano de MTU maximo
CONFIG_BT_GATT_MAX_SR_PROFILES=1
CONFIG_BT_GATT_MAX_SR_ATTRIBUTES=10

# NVS requerido por BT
CONFIG_NVS_ENCRYPTION=n

# FreeRTOS
CONFIG_FREERTOS_HZ=1000
```
